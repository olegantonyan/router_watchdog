## components/clock/Kconfig
```kconfig
menu "Router watchdog clock"

    config RW_TZ
        string "Timezone (POSIX TZ string)"
        default "CET-1CEST,M3.5.0,M10.5.0/3"
        help
            Default is Central Europe with daylight saving. Change at runtime with the 'tz' command.

    config RW_NTP_SERVER1
        string "NTP server 1"
        default "pool.ntp.org"

    config RW_NTP_SERVER2
        string "NTP server 2"
        default "time.google.com"

endmenu
```

## components/inet/Kconfig
```kconfig
menu "Router watchdog internet check"

    config RW_INET_INTERVAL
        int "Check interval while online (s)"
        range 10 3600
        default 30

    config RW_INET_FAIL_ROUNDS
        int "Failed rounds before going offline"
        range 1 10
        default 2
        help
            Consecutive failed rounds needed to switch from online to offline when public pings still pass. A total outage switches after one round. Failed rounds repeat every 10 s.

endmenu
```

## components/led/Kconfig
```kconfig
menu "Router watchdog LED"

    config RW_LED_GPIO
        int "Status LED GPIO"
        default 23
        help
            Single-color status LED, driven by LEDC PWM. GPIO23 (LED D20) on the ESP32-32E N4 relay board.

    config RW_LED_ACTIVE_LOW
        bool "LED is active low"
        default n
        help
            Enable if the LED lights when the GPIO is low (cathode wired to the GPIO).

endmenu
```

## components/net/Kconfig
```kconfig
menu "Router watchdog"

    config RW_HOSTNAME
        string "Hostname (DHCP and mDNS, <name>.local)"
        default "router-watchdog"

    config RW_AP_SSID
        string "Access point SSID"
        default "router-watchdog"
        help
            A -XXXX suffix from the access point MAC address is appended.

    config RW_AP_PASSWORD
        string "Access point password"
        default "watchdog"
        help
            8-63 characters for WPA2-PSK. Leave empty for an open access point.

    config RW_AP_CHANNEL
        int "Access point channel"
        range 1 13
        default 1
        help
            Used until the Wi-Fi client connects; then the access point follows the client's channel.

    config RW_AP_MAX_CONN
        int "Maximum access point clients"
        range 1 10
        default 4

endmenu
```

## components/relay/Kconfig
```kconfig
menu "Router watchdog relays"

    config RW_RELAY_ACTIVE_LOW
        bool "Relays are active low"
        default n
        help
            Enable if a relay switches on when its GPIO is low.

    config RW_RELAY1_GPIO
        int "Relay 1 GPIO (-1: not connected)"
        range -1 33
        default 32

    config RW_RELAY2_GPIO
        int "Relay 2 GPIO (-1: not connected)"
        range -1 33
        default 33

    config RW_RELAY3_GPIO
        int "Relay 3 GPIO (-1: not connected)"
        range -1 33
        default 25

    config RW_RELAY4_GPIO
        int "Relay 4 GPIO (-1: not connected)"
        range -1 33
        default 26

    config RW_RELAY5_GPIO
        int "Relay 5 GPIO (-1: not connected)"
        range -1 33
        default 27

    config RW_RELAY6_GPIO
        int "Relay 6 GPIO (-1: not connected)"
        range -1 33
        default 14

    config RW_RELAY7_GPIO
        int "Relay 7 GPIO (-1: not connected)"
        range -1 33
        default 12

    config RW_RELAY8_GPIO
        int "Relay 8 GPIO (-1: not connected)"
        range -1 33
        default 13

endmenu
```

## components/telnet/Kconfig
```kconfig
menu "Router watchdog telnet"

    config RW_TELNET_ENABLE
        bool "Shell over telnet"
        default y

    config RW_TELNET_PORT
        int "Port"
        range 1 65535
        default 23
        depends on RW_TELNET_ENABLE

    config RW_TELNET_PASSWORD
        string "Password, empty for none"
        default "watchdog"
        depends on RW_TELNET_ENABLE

    config RW_TELNET_IDLE_S
        int "Idle timeout (s), 0 to disable"
        range 0 86400
        default 600
        depends on RW_TELNET_ENABLE

endmenu
```

## components/watchdog/Kconfig
```kconfig
menu "Router watchdog power cycle"

    config RW_WD_RELAY
        int "Relay that cuts the router's power"
        range 1 8
        default 1

    config RW_WD_PULSE_MS
        int "Power-off time (ms)"
        range 500 60000
        default 3000

    config RW_WD_OFFLINE_S
        int "Internet offline before power cycling (s)"
        range 0 3600
        default 30

    config RW_WD_NO_WIFI_S
        int "Wi-Fi without IP before power cycling (s), 0 to disable"
        range 0 86400
        default 300
        help
            Covers a hung router that dropped Wi-Fi, where the internet check can't run. Only counts while a network is saved and not disconnected.

    config RW_WD_GRACE_S
        int "Wait after a power cycle (s)"
        range 60 3600
        default 300
        help
            No new power cycle before this; doubles after each cycle that doesn't bring the internet back, resets once it is online.

    config RW_WD_GRACE_MAX_S
        int "Maximum wait after a power cycle (s)"
        range 60 86400
        default 3600

endmenu
```

## sdkconfig.defaults
```kconfig
CONFIG_IDF_TARGET="esp32"
CONFIG_ESPTOOLPY_FLASHSIZE_4MB=y
CONFIG_PARTITION_TABLE_SINGLE_APP_LARGE=y

CONFIG_ESP_CONSOLE_UART_DEFAULT=y

CONFIG_FREERTOS_USE_TRACE_FACILITY=y
CONFIG_FREERTOS_GENERATE_RUN_TIME_STATS=y

CONFIG_ESP_MAIN_TASK_STACK_SIZE=4096
CONFIG_BOOTLOADER_LOG_LEVEL_WARN=y
CONFIG_LWIP_SNTP_MAX_SERVERS=3

CONFIG_LIBC_NEWLIB=y
CONFIG_LWIP_MAX_SOCKETS=16
```
